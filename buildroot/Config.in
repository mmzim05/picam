## buildroot/configs/picam_defconfig
```kconfig
# PiCam UVC firmware — Buildroot defconfig
# Target: Raspberry Pi Zero 2 W (BCM2710, Cortex-A53, aarch64)

# ── Architecture (aarch64 only — no ARM32 CPU/FPU options) ────────────────
BR2_aarch64=y

# ── Toolchain ─────────────────────────────────────────────────────────────
BR2_TOOLCHAIN_BUILDROOT_GLIBC=y
BR2_TOOLCHAIN_BUILDROOT_CXX=y
BR2_TOOLCHAIN_BUILDROOT_WCHAR=y
BR2_CCACHE=y

# ── System ────────────────────────────────────────────────────────────────
BR2_TARGET_GENERIC_HOSTNAME="picam"
BR2_TARGET_GENERIC_ISSUE=""
BR2_TARGET_GENERIC_ROOT_PASSWD="picam"
BR2_TARGET_GENERIC_REMOUNT_ROOTFS_RW=n
BR2_SYSTEM_DHCP=""

# ── Init: BusyBox (faster than systemd) ──────────────────────────────────
BR2_INIT_BUSYBOX=y
BR2_PACKAGE_BUSYBOX=y
BR2_PACKAGE_BUSYBOX_SHOW_OTHERS=y

# ── Kernel: Raspberry Pi fork ─────────────────────────────────────────────
# rpi-6.6.y is the current LTS RPi kernel with UVC gadget + IMX477 support
BR2_LINUX_KERNEL=y
BR2_LINUX_KERNEL_CUSTOM_GIT=y
BR2_LINUX_KERNEL_CUSTOM_REPO_URL="https://github.com/raspberrypi/linux"
BR2_LINUX_KERNEL_CUSTOM_REPO_VERSION="rpi-6.6.y"
BR2_LINUX_KERNEL_DEFCONFIG="bcm2711"
BR2_LINUX_KERNEL_CONFIG_FRAGMENT_FILES="$(BR2_EXTERNAL_PICAM_PATH)/board/picam/kernel.config"
BR2_LINUX_KERNEL_NEEDS_HOST_OPENSSL=y
BR2_LINUX_KERNEL_DTS_SUPPORT=y
BR2_LINUX_KERNEL_INTREE_DTS_NAME="broadcom/bcm2710-rpi-zero-2-w broadcom/bcm2710-rpi-zero-2"
BR2_LINUX_KERNEL_INSTALL_TARGET=n

# ── Raspberry Pi GPU firmware (start.elf, fixup.dat, overlays) ───────────
BR2_PACKAGE_RPI_FIRMWARE=y

# ── Camera and encoding ───────────────────────────────────────────────────
BR2_PACKAGE_LIBCAMERA=y
BR2_PACKAGE_LIBJPEG_TURBO=y

# ── Application ───────────────────────────────────────────────────────────
BR2_PACKAGE_PICAM_APP=y

# ── Debugging aid (v4l2-ctl) — remove for smallest image ─────────────────
BR2_PACKAGE_V4L_UTILS=y

# ── Root filesystem: squashfs (read-only, fast mount, SD-safe) ───────────
BR2_TARGET_ROOTFS_SQUASHFS=y
BR2_TARGET_ROOTFS_SQUASHFS4_XZ=y

# ── Networking (WiFi debug — remove when shipping) ───────────────────────
BR2_PACKAGE_IFUPDOWN_SCRIPTS=n
BR2_PACKAGE_OPENSSH=n
BR2_PACKAGE_WPA_SUPPLICANT=y
BR2_PACKAGE_WPA_SUPPLICANT_NL80211=y
BR2_PACKAGE_WPA_SUPPLICANT_CTRL_IFACE_UNIX=y
BR2_PACKAGE_DROPBEAR=y
BR2_PACKAGE_BRCMFMAC_SDIO_FIRMWARE_RPI=y
BR2_PACKAGE_BRCMFMAC_SDIO_FIRMWARE_RPI_WIFI=y
BR2_ROOTFS_DEVICE_CREATION_STATIC=y

# ── Post-build / post-image ───────────────────────────────────────────────
BR2_ROOTFS_POST_BUILD_SCRIPT="$(BR2_EXTERNAL_PICAM_PATH)/board/picam/post-build.sh"
BR2_ROOTFS_POST_IMAGE_SCRIPT="$(BR2_EXTERNAL_PICAM_PATH)/board/picam/post-image.sh"

# ── Host tools (built by Buildroot, not installed from apt) ──────────────
BR2_PACKAGE_HOST_GENIMAGE=y
BR2_PACKAGE_HOST_DOSFSTOOLS=y
BR2_PACKAGE_HOST_MTOOLS=y
BR2_PACKAGE_HOST_CMAKE=y
```

## buildroot/package/picam-app/Config.in
```kconfig
config BR2_PACKAGE_PICAM_APP
	bool "picam-app"
	depends on BR2_PACKAGE_LIBCAMERA
	depends on BR2_PACKAGE_LIBJPEG_TURBO
	depends on BR2_INSTALL_LIBSTDCPP
	help
	  Pi HD Camera UVC gadget application.
	  Streams IMX477 frames over USB as a standard UVC webcam.
	  Exposes shutter speed, ISO and white balance as UVC controls.
```
